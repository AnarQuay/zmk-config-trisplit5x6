## boards/shields/trisplit/Kconfig.defconfig
```kconfig
if SHIELD_TRISPLIT_LEFT

config ZMK_KEYBOARD_NAME
    default "trisplit"

config ZMK_SPLIT_ROLE_CENTRAL
    default y

endif # SHIELD_TRISPLIT_LEFT

if SHIELD_TRISPLIT_LEFT || SHIELD_TRISPLIT_RIGHT

config ZMK_SPLIT
    default y

endif # SHIELD_TRISPLIT_LEFT || SHIELD_TRISPLIT_RIGHT
```

## config/boards/Kconfig.shield
```kconfig
config SHIELD_TRISPLIT_LEFT
    def_bool $(shields_list_contains,trisplit_left)

config SHIELD_TRISPLIT_RIGHT
    def_bool $(shields_list_contains,trisplit_right)

config SHIELD_TRISPLIT_MACRO
    def_bool $(shields_list_contains,trisplit_macro)
```
